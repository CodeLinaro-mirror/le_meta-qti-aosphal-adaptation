## conf/layer.conf
```bitbake
BBPATH .= ":${LAYERDIR}"

BBFILE_COLLECTIONS                    += "qti-aosphal-adaptation"
BBFILE_PRIORITY_qti-aosphal-adaptation = "17"
BBFILE_PATTERN_qti-aosphal-adaptation := "^${LAYERDIR}/"

LAYERSERIES_COMPAT_qti-aosphal-adaptation = "kirkstone scarthgap wrynose"

BBFILES += "${LAYERDIR}/recipes/*/*.bb \
            ${LAYERDIR}/recipes/*/*.bbappend"
```
